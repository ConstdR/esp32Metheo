## espidf/main/Kconfig.projbuild
```kconfig
menu "Weather Station Configuration"

    config SLEEP_MINUTES
        int "Deep sleep interval (minutes)"
        default 15
        range 1 60
        help
            How long to sleep between measurements.

    config CONFIG_SEND_INTERVAL
        int "Config broadcast interval (boot cycles)"
        default 24
        range 1 1000
        help
            How often to send device config via MQTT-UDP, in number
            of wake cycles. With 15 min sleep, 24 = every ~6 hours,
            1 = every wake (useful for debugging).

    config LED_GPIO
        int "LED GPIO pin"
        default 5
        help
            GPIO pin number for the status LED.

    config LED_INVERTED
        bool "LED active-low (inverted)"
        default n
        help
            Enable if the LED is connected to VCC and turns on
            when GPIO is LOW (active-low / inverted polarity).

    config I2C_SDA_GPIO
        int "I2C SDA GPIO pin"
        default 21
        range 0 33
        help
            GPIO pin for I2C data line (BME280 / SHT30).

    config I2C_SCL_GPIO
        int "I2C SCL GPIO pin"
        default 22
        range 0 33
        help
            GPIO pin for I2C clock line (BME280 / SHT30).

    config AP_TIMEOUT_SEC
        int "AP mode timeout (seconds)"
        default 300
        range 60 3600
        help
            How long to keep the configuration AP active before
            going to deep sleep. Default is 300 (5 minutes).

    config WIFI_FAIL_THRESHOLD
        int "Wi-Fi failures before AP mode"
        default 5
        range 2 20
        help
            Number of consecutive Wi-Fi connection failures before
            entering AP configuration mode.

    config BATTERY_ADC_GPIO
        int "Battery voltage ADC GPIO pin"
        default 34
        range 32 39
        help
            GPIO pin for battery voltage measurement via resistor divider.
            Must be an ADC1 pin (GPIO 32-39 on ESP32).

    config LOW_BATTERY_MV
        int "Low battery threshold (mV)"
        default 3300
        range 2500 4200
        help
            Battery voltage threshold in millivolts. When voltage drops
            below this value, "low_bat":1 is added to the MQTT payload.

    choice SENSOR_TYPE
        prompt "Temperature/humidity sensor"
        default SENSOR_AUTO
        help
            Select the sensor type. AUTO will probe for SHT30 first
            (at 0x44), and fall back to BME280 (at 0x76) if not found.

        config SENSOR_AUTO
            bool "Auto-detect (SHT30 → BME280)"
        config SENSOR_BME280
            bool "BME280 only"
        config SENSOR_SHT30
            bool "SHT30 only"
    endchoice

    config SOLAR_ENABLED
        bool "Enable solar panel voltage measurement"
        default y
        help
            Enable solar panel voltage measurement on SOLAR_ADC_GPIO.
            Disable this if the device has no solar panel — vs field
            will be omitted from the MQTT-UDP payload.

    config SOLAR_ADC_GPIO
        int "Solar panel voltage ADC GPIO pin"
        default 33
        range 32 39
        depends on SOLAR_ENABLED
        help
            GPIO pin for solar panel voltage measurement via resistor divider.
            Must be an ADC1 pin (GPIO 32-39 on ESP32).

endmenu
```

## espidf/sdkconfig.defaults
```kconfig
# Defaults for Weather Station
# Wi-Fi credentials are now configured via AP mode (captive portal).
# On first boot, the device creates an open AP "Metheo_XXXXXX".
# Connect to it and open http://192.168.4.1 to enter Wi-Fi credentials.

CONFIG_SLEEP_MINUTES=15
CONFIG_LED_GPIO=5
CONFIG_AP_TIMEOUT_SEC=300
CONFIG_WIFI_FAIL_THRESHOLD=5
```
